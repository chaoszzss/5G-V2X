## uboot/board/freescale/mx6q_gao_emmc/Kconfig
```kconfig
if TARGET_MX6Q_GAO_EMMC

config SYS_BOARD
	default "mx6q_gao_emmc"

config SYS_VENDOR
	default "freescale"

config SYS_SOC
	default "mx6"

config SYS_CONFIG_NAME
	default "mx6q_gao_emmc"

endif
```
